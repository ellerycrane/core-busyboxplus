## hg/tarmaker/mercurial/Config.in
```kconfig
config BR2_PACKAGE_MERCURIAL
	bool "mercurial"
	select BR2_PACKAGE_PYTHON
	help
	  Mercurial is a free, distributed source control management tool. 
	  It efficiently handles projects of any size and offers an easy and
	  intuitive interface.

	  https://www.mercurial-scm.org/
```
